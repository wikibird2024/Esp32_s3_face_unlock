## components/display/Kconfig
```kconfig
menu "Display (0.66 inch OLED)"

    comment "64x48 SSD1306 on its own I2C bus. SDA or SCL at -1 = no screen."

    config DISPLAY_SDA_GPIO
        int "SDA GPIO"
        range -1 48
        default 41
        help
            Goes to the pin marked D2 on the OLED board. D1 and D2 are
            D1 mini names, not ESP32 GPIO numbers. Do not use the camera
            bus (GPIO 4 and 5): the OV5640 has the same address, 0x3C.

    config DISPLAY_SCL_GPIO
        int "SCL GPIO"
        range -1 48
        default 42
        help
            Goes to the pin marked D1 on the OLED board.

    config DISPLAY_RESET_GPIO
        int "Reset GPIO (-1 = not wired)"
        range -1 48
        default -1
        help
            Only needed if the reset line of your OLED board is wired to a
            header pin. Check that pin with a meter.

    config DISPLAY_I2C_ADDRESS
        hex "I2C address"
        range 0x3C 0x3D
        default 0x3C
        help
            Set by the 0X3C / 0X3D solder jumper on the OLED board.

    config DISPLAY_UPSIDE_DOWN
        bool "Turn the text upside down"
        default n
        help
            Depends on how the screen is mounted.

endmenu
```

## components/keypad_input/Kconfig
```kconfig
menu "Keypad (4x4)"

    config KEYPAD_ENABLED
        bool "Use a 4x4 matrix keypad"
        default y
        help
            Type a PIN to open the door: digits, then # to submit, * to
            clear. Set the PIN in the console with: pin set <digits>
            There is no default PIN, so no PIN opens the door until then.

    if KEYPAD_ENABLED
        comment "A keypad takes 8 GPIOs. The build stops if one clashes."

        config KEYPAD_ROW1_GPIO
            int "Row 1 GPIO"
            range 0 48
            default 1
        config KEYPAD_ROW2_GPIO
            int "Row 2 GPIO"
            range 0 48
            default 3
        config KEYPAD_ROW3_GPIO
            int "Row 3 GPIO"
            range 0 48
            default 21
        config KEYPAD_ROW4_GPIO
            int "Row 4 GPIO"
            range 0 48
            default 39
        config KEYPAD_COLUMN1_GPIO
            int "Column 1 GPIO"
            range 0 48
            default 38
        config KEYPAD_COLUMN2_GPIO
            int "Column 2 GPIO"
            range 0 48
            default 40
        config KEYPAD_COLUMN3_GPIO
            int "Column 3 GPIO"
            range 0 48
            default 47
        config KEYPAD_COLUMN4_GPIO
            int "Column 4 GPIO"
            range 0 48
            default 48
    endif

endmenu
```

## components/oled_display/Kconfig
```kconfig
menu "OLED display (SSD1306 64x48, I2C)"

    config OLED_DISPLAY_SDA_GPIO
        int "SDA GPIO (-1 = no display)"
        range -1 48
        default -1
        help
            I2C data pin of the 0.66" 64x48 SSD1306 OLED. GPIO 41 is free
            on the default pin map. Do not share the camera's SCCB pins.

    config OLED_DISPLAY_SCL_GPIO
        int "SCL GPIO (-1 = no display)"
        range -1 48
        default -1
        help
            I2C clock pin of the OLED. GPIO 42 is free on the default pin
            map.

    config OLED_DISPLAY_RESET_GPIO
        int "Reset (RS/RST) GPIO (-1 = pin tied to 3V3)"
        range -1 48
        default -1
        help
            SSD1306 reset pin, active low. The firmware pulses it low at
            start, then holds it high. GPIO 40 is free on the default pin
            map. With -1, tie the pin to 3V3: left open, the screen stays
            dark.

    config OLED_DISPLAY_I2C_ADDRESS
        hex "I2C address"
        range 0x3C 0x3D
        default 0x3C
        help
            0x3C on most modules; 0x3D when the address jumper is moved.

    config OLED_DISPLAY_ROTATE_180
        bool "Rotate 180 degrees"
        default n
        help
            Turn on when the text shows upside down.

endmenu
```
